## projects/allstar/limey-linux/tags/1.0.8/buildroot/package/dmidecode/Config.in
```kconfig
config BR2_PACKAGE_DMIDECODE
	bool "dmidecode"
	help
	  DMI Decoder

	  http://www.nongnu.org/dmidecode/
```

## projects/allstar/limey-linux/tags/release-105/buildroot/package/noip/Config.in
```kconfig
config BR2_PACKAGE_NOIP
	bool "noip"
	default n
	help
          A DDNS client for noip.com
```

## projects/allstar/limey-linux/trunk/buildroot/package/inadyn/Config.in
```kconfig
config BR2_PACKAGE_INADYN
	bool "inadyn"
	default n
	help
          A multi protocol capable DDNS client written in C
```

## projects/allstar/limey-linux/trunk/buildroot/package/zsync/Config.in
```kconfig
config BR2_PACKAGE_ZSYNC
	bool "zsync"
	help
	  Zsync partial/differential file distribution

	  http://zsync.moria.org.uk
```
